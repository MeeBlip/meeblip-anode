;-------------------------------------------------------------------------------------------------------------------
; Meeblip anode		Version 1.00
;
;
;-------------------------------------------------------------------------------------------------------------------
;			Wavetables  
;-------------------------------------------------------------------------------------------------------------------
;            
;			Bandlimited sawtooth wavetables (each table is 256 bytes long, unsigned integer)

INV_SAW0:

	; base freqency: 25.96 Hz, discretes: 701, rms: 7.95, min: -0.87, max: 0.87

	.db	  128,   18,   17,   21,    22,   22,   22,   24
	.db	   25,   25,   26,   27,    28,   29,   30,   31
	.db	   32,   32,   33,   34,    35,   36,   37,   38
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	.db	  231,  232,  234,  234,   234,  235,  239,  238


INV_SAW1:
	; base freqency: 41.20 Hz, discrets: 442, rms: 7.95, min: -0.88, max: 0.88

	.db	  128,   17,   16,   21,    23,   21,   22,   25
	.db	   25,   25,   26,   28,    28,   29,   30,   31
	.db	   31,   32,   34,   34,    35,   36,   37,   38
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	.db	  231,  231,  234,  235,   233,  235,  240,  239


INV_SAW2:
	; base freqency: 65.41 Hz, discrets: 278, rms: 7.95, min: -0.85, max: 0.85

	.db	  128,   28,   22,   20,    20,   20,   21,   22
	.db	   24,   26,   27,   28,    29,   29,   30,   30
	.db	   31,   32,   33,   34,    35,   36,   37,   38
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	.db	  232,  234,  235,  236,   236,  236,  234,  228


INV_SAW3:
	; base freqency: 103.83 Hz, discrets: 176, rms: 7.95, min: -0.92, max: 0.92

	.db	  128,   10,   15,   26,    21,   19,   25,   25
	.db	   23,   26,   28,   26,    28,   30,   29,   30
	.db	   33,   32,   33,   35,    35,   35,   37,   38
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	.db	  233,  231,  231,  237,   235,  230,  241,  246


INV_SAW4:
	; base freqency: 164.81 Hz, discrets: 111, rms: 7.95, min: -1.00, max: 1.00

	.db	  128,    1,   27,   19,    21,   25,   20,   28
	.db	   22,   28,   25,   28,    29,   28,   32,   29
	.db	   33,   31,   34,   34,    35,   37,   36,   39
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	.db	  234,  228,  236,  231,   235,  237,  229,  255


INV_SAW5:
	; base freqency: 261.62 Hz, discrets: 70, rms: 7.95, min: -1.00, max: 1.00

	.db	  128,   26,    1,   24,    30,   17,   19,   29
	.db	   27,   21,   26,   31,    27,   26,   32,   33
	.db	   30,   31,   36,   35,    33,   36,   39,   37
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	.db	  229,  227,  237,  239,   226,  232,  255,  230


INV_SAW6:
	; base freqency: 415.30 Hz, discrets: 44, rms: 7.95, min: -1.00, max: 1.00

	.db	  128,   57,   11,    0,    13,   29,   33,   27
	.db	   19,   19,   25,   32,    33,   29,   26,   27
	.db	   32,   36,   36,   33,    32,   34,   38,   40
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	.db	  237,  229,  223,  227,   243,  255,  245,  199


INV_SAW7:
	; base freqency: 659.25 Hz, discrets: 28, rms: 7.95, min: -0.99, max: 0.99

	.db	  128,   81,   41,   14,     2,    3,   12,   23
	.db	   32,   36,   34,   29,    24,   21,   22,   26
	.db	   32,   36,   38,   38,    36,   33,   32,   33
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	.db	  224,  233,  244,  253,   254,  242,  215,  175


INV_SAW8:
	; base freqency: 1046.50 Hz, discrets: 18, rms: 7.95, min: -0.98, max: 0.98

	.db	  128,   97,   68,   43,    24,   11,    4,    3
	.db	    6,   12,   20,   28,    34,   38,   40,   39
	.db	   37,   34,   30,   28,    27,   27,   29,   33
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	.db	  250,  253,  252,  245,   232,  213,  188,  159


INV_SAW9:
	; base freqency: 1661.21 Hz, discrets: 11, rms: 7.95, min: -0.97, max: 0.97

	.db	  128,  109,   90,   73,    56,   42,   30,   20
	.db	   12,    8,    5,    5,     6,    9,   13,   18
	.db	   24,   29,   34,   38,    42,   44,   46,   47
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	.db	  244,  236,  226,  214,   200,  183,  166,  147


INV_SAW10:
	; base freqency: 2637.01 Hz, discrets: 7, rms: 7.95, min: -0.94, max: 0.94

	.db	  128,  116,  104,   91,    80,   69,   58,   49
	.db	   40,   32,   26,   20,    15,   12,   10,    8
	.db	    8,    8,    9,   11,    14,   17,   20,   24
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	.db	  216,  207,  198,  187,   176,  165,  152,  140


INV_SAW11:
	; base freqency: 4185.98 Hz, discrets: 5, rms: 7.95, min: -0.92, max: 0.92

	.db	  128,  119,  110,  101,    93,   84,   76,   68
	.db	   60,   53,   47,   41,    35,   30,   26,   22
	.db	   19,   16,   14,   12,    11,   11,   11,   11
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	.db	  196,  188,  180,  172,   163,  155,  146,  137

; 16 wavetables. Each is 256 bytes, 16-bit signed samples.
WAVES:
; WAVETABLE BANK A
;
; sawtooth
.dw 0,   256,   512,   767,  1023,  1279,  1536,  1791,  2049,   2303,  2560,  2816,  3072,  3328,  3584,  3840,  4096,  4351,  4608,   4864,  5119,  5376,  5632,  5889,  6144,  6400,  6656,  6912,  7168,   7424,  7680,  7937,  8192,  8448,  8704,  8960,  9216,  9472,  9728,   9984, 10240, 10496, 10751, 11008, 11263, 11520, 11775, 12031, 12287,  12543, 12799, 13055, 13313, 13566, 13825, 14077, 14338, 14588, 14851,  15099, 15364, 15610, 15877, 16122, 16391, 16632, 16902, 17145, 17413,  17659, 17923, 18174, 18432, 18689, 18938, 19208, 19442, 19728, 19946,  20251, 20448, 20772, 20949, 21295, 21451, 21814, 21956, 22332, 22465,  22845, 22979, 23352, 23500, 23850, 24030, 24341, 24568, 24822, 25116,  25293, 25672, 25757, 26237, 26214, 26805, 26668, 27375, 27124, 27942,  27584, 28498, 28059, 29040, 28552, 29558, 29073, 30042, 29635, 30479,  30252, 30848, 30957, 31099, 31825, 31104, 32767, 30249, 32767,-13408, -32767,-29119,-32768,-30019,-32768,-30087,-31924,-29930,-31114,-29675, -30377,-29363,-29687,-29009,-29036,-28619,-28417,-28200,-27827,-27753, -27263,-27282,-26720,-26790,-26198,-26280,-25690,-25758,-25193,-25228, -24704,-24690,-24218,-24151,-23733,-23612,-23249,-23074,-22759,-22540, -22266,-22013,-21769,-21489,-21267,-20968,-20760,-20453,-20250,-19941, -19737,-19430,-19223,-18922,-18706,-18414,-18190,-17907,-17674,-17399, -17158,-16891,-16643,-16381,-16129,-15871,-15614,-15360,-15102,-14850, -14590,-14337,-14077,-13825,-13566,-13313,-13054,-12801,-12543,-12289, -12031,-11777,-11519,-11264,-11007,-10752,-10495,-10240, -9984, -9728,  -9472, -9216, -8959, -8704, -8447, -8191, -7937, -7680, -7423, -7168,  -6912, -6656, -6400, -6143, -5888, -5632, -5376, -5120, -4864, -4608,  -4352, -4096, -3840, -3584, -3327, -3071, -2816, -2560, -2303, -2048,  -1792, -1536, -1280, -1024,  -767,  -512,  -256
; blended 4 
.dw  162,   726,  1289,  1855,  2424,  2991,  3561,  4131,  4704,   5273,  5847,  6422,  6997,  7570,  8149,  8724,  9302,  9878, 10457,  11034, 11614, 12192, 12775, 13354, 13935, 14516, 15099, 15678, 16261,  16844, 17424, 18010, 18590, 19175, 19757, 20343, 20923, 21511, 22089,  22679, 23257, 23848, 24423, 25016, 25592, 26187, 26761, 27356, 27931,  28525, 29100, 29696, 30271, 30866, 31437, 32060, 32301, 28233, 20874,  15080, 11618,  9638,  8474,  7857,  7532,  7424,  7423,  7518,  7657,   7841,  8055,  8285,  8543,  8806,  9102,  9389,  9713, 10026, 10377,  10711, 11084, 11438, 11832, 12207, 12619, 13014, 13440, 13857, 14295,  14733, 15178, 15641, 16088, 16573, 17025, 17534, 17984, 18517, 18964,  19519, 19963, 20543, 20981, 21583, 22014, 22636, 23065, 23704, 24130,  24781, 25204, 25878, 26195, 23018, 18797, 12005,  5436,  -255, -4955,  -8303,-11031,-12923,-14527,-15568,-16490,-17022,-17522,-17747,-17983, -18023,-18087,-18014,-17964,-17822,-17693,-17506,-17321,-17106,-16880, -16643,-16385,-16131,-15849,-15581,-15278,-14994,-14676,-14380,-14047, -13737,-13392,-13066,-12715,-12377,-12014,-11662,-11291,-10925,-10549, -10171, -9785, -9394, -9004, -8601, -8205, -7790, -7384, -6961, -6549,  -6117, -5699, -5258, -4831, -4381, -3949, -3491, -3051, -2588, -2141,  -1670, -1217,  -740,  -284,   224,   357, -3820,-11281,-17179,-20735, -22813,-24069,-24778,-25191,-25387,-25471,-25455,-25397,-25287,-25155, -24991,-24810,-24606,-24389,-24155,-23904,-23642,-23363,-23075,-22770, -22457,-22130,-21793,-21441,-21084,-20715,-20337,-19946,-19552,-19143, -18731,-18307,-17878,-17439,-16995,-16543,-16087,-15623,-15151,-14677, -14194,-13710,-13218,-12722,-12221,-11716,-11207,-10695,-10178, -9657,  -9133, -8607, -8076, -7542, -7006, -6466, -5926, -5383, -4837, -4288,  -3738, -3186, -2632, -2076, -1518,  -958,  -398
; square
.dw 0, 32767, 30196, 32767, 31584, 32767, 32129, 32767, 32437,  32767, 32637, 32767, 32767, 32709, 32767, 32634, 32767, 32589, 32767,  32569, 32767, 32569, 32767, 32583, 32767, 32606, 32767, 32635, 32767,  32667, 32767, 32699, 32767, 32727, 32767, 32752, 32767, 32767, 32755,  32767, 32744, 32767, 32736, 32767, 32734, 32767, 32734, 32767, 32738,  32767, 32743, 32767, 32750, 32767, 32755, 32767, 32761, 32767, 32765,  32766, 32767, 32764, 32767, 32763, 32767, 32762, 32767, 32764, 32767,  32767, 32766, 32767, 32762, 32767, 32756, 32767, 32749, 32767, 32744,  32767, 32739, 32767, 32735, 32767, 32733, 32767, 32736, 32767, 32743,  32767, 32754, 32767, 32767, 32751, 32767, 32727, 32767, 32698, 32767,  32666, 32767, 32635, 32767, 32606, 32767, 32582, 32767, 32569, 32767,  32569, 32767, 32590, 32767, 32634, 32767, 32708, 32767, 32767, 32637,  32767, 32437, 32767, 32129, 32767, 31585, 32767, 30196, 32767,     0, -32767,-30196,-32768,-31585,-32768,-32129,-32767,-32436,-32768,-32637, -32768,-32768,-32708,-32768,-32634,-32768,-32590,-32768,-32569,-32768, -32569,-32768,-32581,-32768,-32606,-32767,-32635,-32768,-32667,-32768, -32699,-32768,-32727,-32768,-32752,-32768,-32768,-32754,-32768,-32742, -32768,-32737,-32768,-32734,-32768,-32734,-32768,-32738,-32768,-32743, -32768,-32749,-32768,-32755,-32768,-32761,-32768,-32766,-32767,-32767, -32764,-32768,-32762,-32768,-32763,-32768,-32763,-32768,-32767,-32766, -32768,-32761,-32767,-32755,-32768,-32750,-32768,-32744,-32768,-32739, -32768,-32735,-32768,-32734,-32767,-32737,-32767,-32743,-32768,-32755, -32768,-32768,-32751,-32768,-32726,-32767,-32699,-32768,-32667,-32768, -32635,-32768,-32606,-32767,-32582,-32768,-32569,-32768,-32570,-32768, -32590,-32768,-32634,-32768,-32708,-32767,-32768,-32638,-32767,-32436, -32768,-32129,-32768,-31585,-32767,-30196,-32768
;fm synth 2
.dw 527,  5334,  9606, 13051, 15881, 18006, 19622, 20680, 21348,  21556, 21412, 20822, 19831, 18314, 16266, 13557, 10183,  6051,  1228,  -4264,-10208,-16363,-22273,-27434,-31151,-32733,-31465,-26878,-18871,  -8200,  3588, 15344, 24637, 29171, 27710, 20217,  7858, -6930,-20948, -30459,-32355,-24847, -9582,  8425, 23493, 29421, 23725,  8678,-10532, -26530,-32753,-25065, -6313, 14798, 28143, 26548, 11235,-10333,-27900, -32213,-19626,  3191, 23343, 29104, 17274, -4770,-25281,-32633,-21410,   1963, 23108, 29056, 16521, -6162,-26394,-32407,-19632,  4135, 24331,  28709, 15398, -7058,-26557,-32478,-20677,  1803, 22288, 29366, 19939,    114,-20369,-31974,-28954,-12558,  8611, 25011, 29151, 20318,  3297, -15304,-28733,-32585,-25326,-10004,  7503, 22033, 29076, 27317, 18441,   5214, -8983,-21358,-29622,-32700,-30323,-23393,-13355, -2472,  7926,  17034, 23753, 27820, 29386, 28873, 26789, 23648, 19910, 15956, 12080,   8498,  5345,  2716,   661,  -797, -1647, -1888, -1519,  -539,  1048,   3230,  5984,  9246, 12926, 16852, 20800, 24444, 27381, 29125, 29143,  26930, 22101, 14591,  4893, -5809,-16761,-26122,-31755,-32328,-27291, -17203, -3652, 10740, 22769, 29011, 26965, 15908,  -950,-18389,-30505, -31920,-22214, -4716, 14206, 27152, 27955, 14734, -6509,-25733,-32738, -23780, -3736, 17517, 29040, 23284,  2634,-20775,-32642,-25416, -4245,  18515, 29344, 20174, -3635,-26191,-32257,-18075,  6245, 25783, 27338,   8874,-16924,-32186,-26426, -4765, 18772, 29372, 19180, -5212,-27124, -31987,-17460,  6262, 25323, 28063, 12188,-12087,-29976,-30792,-15407,   6900, 24683, 28863, 16792, -4702,-24377,-32768,-26415, -9810,  9873,  24693, 29312, 21701,  5344,-13009,-27342,-32740,-28525,-17098, -2099,  12547, 23648, 29027, 27934, 20938,  9871, -2445,-14128,-23832,-30029, -32646,-31906,-28641,-23511,-17391,-10815, -4431
; distorted 2
.dw 5734, 20539, 20271, 24397, 24697, 27348, 27837, 29949, 30675,  32679, 32623, 32767, 32667, 32767, 32719, 32767, 32760, 32756, 32767,  32730, 32767, 32713, 32767, 32705, 32767, 32702, 32767, 32704, 32767,  32712, 32767, 32721, 32767, 32731, 32767, 32742, 32767, 32751, 32767,  32760, 32767, 32767, 32764, 32767, 32760, 32767, 32757, 32767, 32756,  32767, 32756, 32767, 32759, 32767, 32760, 32767, 32762, 32767, 32764,  32767, 32766, 32767, 32767, 32766, 32767, 32764, 32767, 32764, 32767,  32765, 32767, 32766, 32767, 32766, 32766, 32767, 32762, 32767, 32760,  32767, 32756, 32767, 32752, 32767, 32748, 32767, 32745, 32767, 32744,  32767, 32745, 32767, 32748, 32767, 32756, 32767, 32765, 32763, 32767,  32748, 32767, 32731, 32767, 32711, 32767, 32690, 32767, 32670, 32767,  32651, 32767, 32638, 32767, 32632, 32767, 32633, 32767, 32648, 32767,  31680, 30354, 29076, 27632, 26449, 24453, 23307, 19862, 18880, -5575, -20481,-20237,-24362,-24679,-27367,-27863,-29966,-30703,-32697,-32624, -32768,-32669,-32767,-32721,-32768,-32761,-32755,-32768,-32729,-32768, -32713,-32768,-32703,-32768,-32701,-32767,-32705,-32768,-32711,-32768, -32721,-32768,-32731,-32768,-32741,-32768,-32752,-32767,-32760,-32767, -32767,-32764,-32768,-32760,-32768,-32757,-32768,-32756,-32768,-32757, -32768,-32757,-32768,-32760,-32768,-32762,-32768,-32764,-32768,-32766, -32767,-32768,-32765,-32768,-32765,-32768,-32764,-32768,-32764,-32768, -32765,-32767,-32766,-32765,-32768,-32763,-32768,-32760,-32768,-32756, -32768,-32752,-32768,-32748,-32767,-32746,-32767,-32745,-32768,-32745, -32768,-32748,-32767,-32755,-32767,-32764,-32764,-32768,-32749,-32768, -32731,-32768,-32712,-32767,-32691,-32768,-32670,-32768,-32652,-32768, -32638,-32768,-32631,-32768,-32632,-32767,-32646,-32768,-31655,-30350, -29100,-27651,-26463,-24482,-23340,-19873,-18795
; granular 3
.dw 647,  1913,  3225,  4505,  5821,  7089,  8375,  9602, 10850,  12016, 13191, 14285, 15375, 16400, 17398, 18348, 19251, 20125, 20931,  21751, 22454, 23222, 23826, 24548, 25058, 25745, 26166, 26816, 27155,  27770, 28038, 28613, 28827, 29354, 29531, 29997, 30161, 30547, 30720,  31003, 31218, 31381, 31656, 31672, 32044, 31891, 32378, 32038, 32662,  32120, 32767, 32144, 32767, 31996, 32632, 31031, 31855, 30025, 31057,  28969, 30338, 27756, 30124, 22789,-25279,-30325,-28176,-29820,-28281, -29642,-28265,-29465,-28192,-29226,-28076,-28934,-27920,-28586,-27706, -28179,-27442,-27724,-27109,-27211,-26711,-26645,-26235,-26022,-25675, -25333,-25031,-24580,-24298,-23759,-23460,-22853,-22521,-21859,-21483, -20769,-20323,-19568,-19044,-18254,-17646,-16815,-16112,-15240,-14448, -13538,-12658,-11698,-10735, -9732, -8707, -7675, -6594, -5535, -4429,  -3366, -2269, -1225,  -154,   845,  1859,  2762,  3588,  4372,  5145,   5880,  6588,  7262,  7908,  8530,  9118,  9684, 10214, 10722, 11204,  11666, 12100, 12509, 12902, 13262, 13619, 13930, 14252, 14513, 14806,  15023, 15289, 15459, 15697, 15830, 16046, 16144, 16333, 16401, 16561,  16614, 16737, 16781, 16867, 16910, 16950, 17003, 16995, 17066, 17003,  17102, 16973, 17106, 16919, 17090, 16837, 17041, 16733, 16976, 16615,  16883, 16474, 16772, 16313, 16663, 16089, 16699, 14561, 11332, 12295,  12131, 12978, 12671, 13797, 13049, 14850, 12897, 17235, -1420,-18809, -14923,-17663,-16343,-17900,-17317,-18353,-18143,-18861,-18901,-19406, -19608,-19949,-20262,-20485,-20873,-21008,-21429,-21503,-21928,-21956, -22366,-22361,-22730,-22705,-23015,-22970,-23204,-23140,-23290,-23201, -23255,-23125,-23074,-22894,-22733,-22486,-22202,-21867,-21453,-21012, -20457,-19889,-19183,-18463,-17597,-16720,-15678,-14627,-13406,-12173, -10794, -9385, -7839, -6277, -4593, -2917, -1117
; hvoice 4
.dw 487,  1359,  1586,  1454,  1442,  1716,  2118,  2407,  2717,   3241,  4065,  5234,  6766,  8447,  9982, 11285, 12619, 14271, 16092,  17629, 18876, 20430, 22756, 25559, 28060, 29844, 31167, 32292, 32767,  31949, 29642, 26716, 24278, 22861, 22349, 22650, 23945, 26069, 28041,  28634, 27563, 25862, 24843, 24743, 24675, 23749, 21887, 19594, 17265,  14971, 12753, 10821,  9403,  8628,  8524,  8942,  9511,  9798,  9569,   8859,  7798,  6541,  5431,  4956,  5255,  5788,  5667,  4312,  1842,  -1056, -3541, -5004, -5363, -5125, -4924, -4969, -5028, -4994, -5168,  -5842, -6781, -7382, -7295, -6613, -5502, -4025, -2475, -1551, -1926,  -3487, -5252, -6152, -5951, -5351, -5323, -6309, -7992, -9789,-11339, -12437,-12648,-11421, -8743, -5594, -3402, -3012, -4252, -6413, -8890, -11350,-13580,-15433,-16923,-18194,-19391,-20560,-21585,-22152,-21893, -20712,-18903,-16909,-15036,-13542,-12792,-13087,-14244,-15717,-17129, -18489,-19794,-20748,-21129,-21175,-21272,-21300,-20694,-19144,-16890, -14288,-11466, -8608, -6313, -5240, -5464, -6401, -7402, -8136, -8436,  -8072, -6868, -4969, -2858, -1076,    87,   740,  1322,  2239,  3489,   4669,  5371,  5501,  5231,  4790,  4373,  4175,  4319,  4802,  5587,   6639,  7750,  8485,  8513,  7962,  7286,  6771,  6386,  6105,  6065,   6198,  6022,  5103,  3630,  2290,  1602,  1516,  1667,  1760,  1665,   1413,  1249,  1445,  1961,  2378,  2225,  1322,  -199, -2076, -3954,  -5442, -6400, -7069, -7679, -8057, -7831, -6946, -5762, -4634, -3720,  -3295, -3793, -5174, -6622, -7218, -6885, -6319, -6030, -5773, -5139,  -4272, -3688, -3621, -3867, -4171, -4541, -5051, -5491, -5521, -5129,  -4750, -4865, -5409, -5638, -4857, -3271, -1883, -1503, -2091, -2970,  -3634, -4032, -4199, -4082, -3936, -4197, -4910, -5531, -5479, -4788,  -4083, -3720, -3467, -3156, -2821, -2162,  -871
; hvoice 10
.dw 27,   674,  1351,  2136,  3028,  4110,  5320,  6672,  8148,   9846, 11664, 13369, 15038, 16615, 18095, 19591, 20751, 21733, 23186,  24187, 25139, 26153, 26548, 27220, 28390, 29537, 30104, 30350, 30864,  31534, 32188, 32431, 32609, 32684, 30672, 26836, 21599, 15556,  9952,   4966,  1070, -1895, -3363, -3232, -2985, -3208, -2306,  -306,   697,    537,   272,   -23, -1041, -3208, -6160, -9036,-11673,-13980,-16086, -17989,-19098,-19915,-21308,-23212,-24717,-25447,-25753,-26032,-25829, -24695,-23530,-22783,-22089,-20845,-18783,-16360,-14100,-11875, -9481,  -7492, -6371, -5749, -5092, -4113, -3301, -3064, -2822, -2499, -2289,  -2206, -2089, -1353,   152,  2180,  4421,  7092, 10133, 12844, 14926,  16431, 17867, 19388, 20771, 22035, 23125, 23894, 24105, 23533, 22431,  21203, 19997, 18725, 17458, 16273, 15104, 13982, 12914, 12059, 11562,  11377, 11483, 11674, 11814, 11886, 11713, 11119, 10104,  8818,  7332,   5738,  4108,  2581,  1195,  -317, -2048, -3945, -6012, -8101,-10115, -11932,-13450,-14716,-15758,-16605,-17251,-17670,-17835,-17769,-17418, -16704,-15829,-15010,-14252,-13577,-13044,-12735,-12638,-12642,-12718, -12862,-13115,-13445,-13705,-13826,-13816,-13514,-12696,-11355, -9648,  -7735, -5673, -3539, -1511,   335,  2071,  3740,  5316,  6717,  7878,   8802,  9463,  9886, 10114, 10178, 10165, 10177, 10186, 10153, 10192,  10237, 10316, 10423, 10616, 10999, 11547, 12193, 12788, 13296, 13696,  13916, 13867, 13641, 13271, 12795, 12174, 11307, 10052,  8124,  5631,   3066,   659, -1609, -3565, -5437, -7358, -8899, -9993,-10918,-11663, -12134,-12448,-12676,-12820,-12868,-13009,-13453,-14077,-14548,-14945, -15317,-15548,-15890,-16447,-17038,-17506,-17974,-18436,-18650,-18637, -18539,-18213,-17572,-16683,-15633,-14374,-12839,-11143, -9347, -7615,  -6193, -4989, -3830, -2862, -2068, -1332,  -649

; Wavetable BANK B
;
; bit reduced 30
.dw -13771,  8621, 32077, 29317, 29797, 30406, 28872, 31887, 17041,   7321,  9816,  8561,  9271,  8864,  9073,  8994,  8976,  9055,  8927,   9082,  8902,  9090,  8896,  9084,  8898,  9068,  8909,  9048,  8922,   9025,  8936,  9002,  8950,  8980,  8962,  8960,  8970,  8944,  8974,   8932,  8974,  8926,  8969,  8924,  8960,  8927,  8944,  8932,  8927,   8942,  8907,  8955,  8885,  8968,  8861,  8980,  8839,  8992,  8821,   8998,  8808,  8998,  8803,  8990,  8809,  8968,  8827,  8930,  8865,   8874,  8924,  8793,  9013,  8674,  9142,  8506,  9338,  8244,  9684,   7718, 10667,  3645, -1991,  2414, -5868, -1720,  -306, -4580, -2396,   1965, -2176, -2549,  2881, -4043, -2996, -1781,   683,  -297, -5855,    -69, -1657, -5158,    84,   907, -3217,  -588,  2063, -6041,  -271,   9558,  8367,  9190,  8573,  9033,  8699,  8928,  8780,  8858,  8832,   8814,  8858,  8793,  8862,  8790,  8850,  8802,  8826,  8824,  8791,   8854,  8753,  8883,  8714,  8911,  8682,  8933,  8659,  8941,  8649,   8932,  8659,  8900,  8696,  8836,  8772,  8729,  8898,  8576,  8910,  -2375,  -344, -4403, -2945,  2540, -3094, -1599,  1543, -2588, -5002,    685, -3429, -4296,  1029,  -111, -3809,  1302, -9488, -5081, -1088,  -1724,  2327, -5826, -1879,  -671, -3785, -4568, -8400,-13363,-11464, -12461,-11914,-12184,-12096,-12049,-12185,-11979,-12228,-11943,-12243, -11929,-12239,-11930,-12222,-11940,-12197,-11956,-12168,-11976,-12137, -11996,-12105,-12014,-12076,-12030,-12051,-12041,-12029,-12049,-12011, -12052,-11997,-12051,-11987,-12047,-11980,-12040,-11975,-12034,-11971, -12024,-11968,-12012,-11965,-12001,-11964,-11991,-11963,-11979,-11962, -11966,-11962,-11955,-11962,-11941,-11962,-11928,-11963,-11915,-11963, -11906,-11954,-11907,-11929,-11934,-11860,-12043,-11640,-12480,-10446, -22565,-32768,-30910,-32768,-31221,-32768,-31247
; bit reduced 8
.dw 3875,  7912, 10994, 14617, 16951, 16047, 16598, 16250, 16442,  16343, 11602, 10814, 10829, 11303,  7514,  4963,  5705,  5342,  5386,    565,  -250,   261,  -347,   569, -2094, -5721, -5401, -5425, -5552,  -5322, -5636, -5242, -5734, -5061, -6527,-10926,-10962,-10852,-11006, -10833,-11010,-10836,-11000,-10854,-10978,-10880,-10947,-10917,-10904, -10969,-10838,-11062,-10683,-11411, -8080, -4898, -5781, -5227, -5654,  -5281, -5645, -5241, -5787, -4507,    13,    41,  -118,   230,  -490,   3255,  5917,  5298,  5381,  9344, 11469, 10558, 11275, 15449, 16850,  15982, 16793, 15893, 17123, 13330, 10746,  6608,  -152, -9850,-19389, -22207,-28880,-32768,-32719,-32761,-32767,-32682,-32768,-28105,-27278, -26059,-20990,-22683,-17367,-16541,-15314,-10807,-10883,-11153, -6796,  -5183, -4795,   825,  -957,  4054,  5195,  8200, 11421, 10854, 15984,  16532, 16184, 16755, 12805,  8890,  1715,-10411,-19548,-26909,-31101, -32767,-32436,-32768,-32443,-32768,-28593,-27174,-26545,-21351,-22415, -18679,-15784,-16972,-14963,-10940,-10700,-11433, -8828, -5152, -5423,  -5857, -2636,   508,  -168,  -133,  3495,  6156,  4848,  6952, 11125,  10726, 11182, 10438, 13879, 16864, 16117, 16562, 16247, 16493, 16285,  16476, 16280, 16510, 16185, 16787, 13015, 10326, 11328, 10565, 11286,  10495, 11558,  8712,  5106,  5583,  5429,  5436,  5531,  5332,  5680,   5010,  7684, 11508, 10565, 11206, 10658, 11209, 10530, 12010, 16466,  16355, 16376, 16407, 16346, 16426, 16331, 16440, 16315, 16465, 16263,  16592, 12175, 10480, 11276, 10530, 11513,  7090,  5188,  5486,  5590,    968,  -193,   -32,   328, -2931, -6134, -5014, -5839, -5112,-10374, -10869,-11152,-10423,-14267,-16816,-16241,-16249,-17925,-22650,-21090, -23917,-27766,-26815,-29255,-32767,-32427,-32768,-32539,-32767,-32528, -32768,-31444,-26549,-22786,-17836,-11943, -2669
; bit reduced 22
.dw 11517, 17755, 15571, 16968, 15923, 16759, 16067, 16650, 16155,  16578, 16216, 16526, 16263, 16484, 16299, 16452, 16328, 16425, 16352,  16404, 16371, 16385, 16391, 16367, 16410, 16346, 16432, 16323, 16457,  16297, 16485, 16267, 16517, 16233, 16550, 16199, 16584, 16167, 16614,  16139, 16638, 16122, 16648, 16119, 16641, 16138, 16607, 16187, 16539,  16280, 16415, 16442, 16203, 16732, 15791, 17360, 14688, 19908,-17046, -32768,-30350,-32768,-31470,-32767,-31925,-32768,-32200,-32768,-32395, -32768,-32543,-32768,-32656,-32768,-32741,-32760,-32768,-32709,-32768, -32678,-32768,-32665,-32768,-32663,-32768,-32672,-32768,-32685,-32768, -32700,-32768,-32714,-32768,-32725,-32767,-32727,-32768,-32722,-32768, -32710,-32768,-32688,-32767,-32659,-32768,-32622,-32768,-32576,-32767, -32522,-32768,-32444,-32768,-32280,-32768,-30648,-16682,-16256,-16530, -16214,-16566,-16190,-16579,-16189,-16570,-16208,-16543,-16245,-16494, -16305,-16416,-16406,-16284,-16594,-15984,-17214,-13240,   559,  -232,    -14,   273,  -654,  1448,-25084,-32768,-31424,-32768,-32008,-32768, -32240,-32768,-32374,-32768,-32469,-32767,-32543,-32768,-32608,-32768, -32676,-32768,-32768,-32690,-32768,-18942,-15559,-16901,-15983,-16722, -16080,-16664,-16118,-16640,-16132,-16632,-16132,-16638,-16121,-16655, -16094,-16693,-16038,-16784,-15873,-17175,-13982,   -14,   -29,   -22,     60,   -87,   107,  -124,   138,  -152,   166,  -180,   195,  -214,    236,  -264,   302,  -353,   431,  -559,   802, -1434,  5800, 17766,  15664, 16846, 16057, 16618, 16215, 16495, 16321, 16397, 16417, 16297,  16527, 16172, 16676, 15990, 16910, 15667, 17397, 14812, 19393,  1876, -19622,-14610,-17618,-15391,-17354,-14505,  -787,   299,  -193,   133,    -88,    51,   -22,    -3,    22,   -34,    43,   -45,    41,   -29,      9,    23,   -69,   141,  -257,   478, -1034
; distorted 1
.dw 1343, 19506, 19765, 23662, 24317, 26801, 27634, 29583, 30653,  32531, 32732, 32767, 32757, 32760, 32767, 32730, 32767, 32709, 32767,  32698, 32767, 32694, 32767, 32697, 32767, 32703, 32767, 32713, 32767,  32725, 32767, 32737, 32767, 32747, 32767, 32757, 32767, 32765, 32766,  32767, 32761, 32767, 32757, 32767, 32755, 32767, 32755, 32767, 32756,  32767, 32757, 32767, 32760, 32767, 32761, 32767, 32763, 32767, 32765,  32767, 32766, 32767, 32766, 32767, 32767, 32767, 32766, 32767, 32765,  32767, 32765, 32767, 32764, 32767, 32763, 32767, 32761, 32767, 32762,  32767, 32762, 32767, 32763, 32767, 32765, 32766, 32767, 32762, 32767,  32757, 32767, 32750, 32767, 32742, 32767, 32736, 32767, 32730, 32767,  32725, 32767, 32724, 32767, 32726, 32767, 32733, 32767, 32746, 32767,  32764, 32757, 32767, 32728, 32767, 32694, 32767, 32652, 32767, 32605,  32767, 32545, 32767, 31947, 31249, 29683, 29185, 27400, 26874, 24712,  24017, 21054, 19922, 12085,-14772,-20355,-22044,-24660,-25759,-27892, -28822,-30813,-32016,-32768,-32492,-32768,-32547,-32768,-32591,-32768, -32632,-32768,-32669,-32768,-32705,-32767,-32735,-32768,-32759,-32765, -32768,-32748,-32768,-32737,-32768,-32732,-32768,-32729,-32768,-32730, -32768,-32735,-32768,-32740,-32768,-32746,-32768,-32752,-32768,-32758, -32768,-32763,-32768,-32767,-32765,-32768,-32763,-32768,-32762,-32767, -32760,-32768,-32761,-32768,-32762,-32768,-32762,-32768,-32764,-32768, -32766,-32766,-32767,-32764,-32768,-32761,-32768,-32758,-32768,-32756, -32768,-32754,-32768,-32753,-32767,-32753,-32767,-32754,-32768,-32757, -32768,-32762,-32767,-32768,-32758,-32767,-32749,-32768,-32735,-32768, -32721,-32768,-32708,-32767,-32696,-32768,-32687,-32768,-32681,-32768, -32682,-32768,-32691,-32768,-32708,-32767,-32008,-30969,-30115,-28985, -28183,-26720,-25967,-23877,-23212,-19652,-19303
; distorted 25
.dw 1830, 10464, 11961,  6552,  2812, 11599, 17347, 14373,  8214,   8602, 15417, 18771, 17674, 12941, 12609, 18058, 21090, 18984, 14213,  15538, 20549, 21392, 17340, 14874, 19160, 22008, 20550, 18004, 17574,  18542, 20153, 21926, 21292, 19549, 19996, 21694, 22104, 23166, 24176,  24103, 23627, 24294, 25406, 26062, 26752, 27470, 27878, 26895, 27112,  29112, 30485, 29222, 27512, 28544, 31011, 30946, 30013, 28491, 30183,  31089, 31136, 29643, 29971, 30929, 30766, 29519, 29475, 30786, 30212,  29470, 27333, 27068, 26757, 30008, 27847, 23492, 19609, 30808, 15166, -24113,-28676, 18330, 15686,-30390,-32283,-28086,-21568,-31106,-32475, -32159,-31739,-32007,-32768,-32322,-32658,-31962,-32768,-32434,-32768, -31320,-31790,-32143,-32767,-31133,-29078,-29386,-31416,-30344,-27431, -21039,-21905,-24736,-24607, -9306, 10959,   967,-12309,  4521, 20236,  18311,  7051, 10115, 21112, 21475, 10419,  2023, 12499, 18188,  8686,  -9831,-13757, -5020, -5384,-16940,-21627,-18894,-18702,-23239,-25047, -22619,-22546,-25159,-26014,-24242,-23324,-23397,-23410,-22607,-21409, -19947,-19599,-18690,-12937, -1632, -1662,-11099, -6622, 10860, 18096,  16041, 13906, 15196, 18931, 21303, 22459, 21553, 21671, 22171, 21716,  19362, 20135, 22972, 23019, 17306, 11644, 16758, 21167, 17818,  5705,   1627,  9260,  9201,   946, -6018, -7561, -7875, -3094, -5560,-14350, -15566, -7111, -6131,-14836,-16108,-11874, -9567,-11457,-11939,-10367,  -6708, -5164, -7580, -7985, -3883,  -495,  2587,  5435,  4351,  2901,   6161,  8184,  9196, 10777,  8899,   105,   449, 11091, 14716,  5885,  -8163, -6702,  5579, 12036,  -710,-14887,-13688,  -109,  1157,-12677, -15369,-10261,-10924,-16570,-15094, -8971,-10306,-17161,-18720,-14710,  -9277, -9465,-13222,-15645,-15658, -9723, -1962, -6014,-13125, -8907,    632, -2078, -8652,  -474,  7765,  3308, -4282
; fm synth 11
.dw 1384,  6519, 11443, 16039, 20031, 23349, 25917, 27790, 29026,  29762, 30123, 30253, 30256, 30233, 30224, 30243, 30237, 30110, 29699,  28799, 27148, 24492, 20569, 15262,  8577,   978, -7188,-15620,-23243, -29020,-32131,-32129,-28950,-22945,-14781, -5365,  4304, 13275, 20751,  26187, 29320, 30174, 29011, 26271, 22466, 18126, 13714,  9609,  6051,   3191,  1076,  -280,  -911,  -843,  -102,  1288,  3299,  5880,  8942,  12350, 15932, 19483, 22788, 25641, 27873, 29364, 30062, 29982, 29199,  27843, 26073, 24066, 22003, 20045, 18345, 17010, 16147, 15805, 16031,  16822, 18160, 19971, 22146, 24501, 26793, 28703, 29855, 29830, 28226,  24725, 19186, 11774,  3087, -6007,-15128,-23203,-29113,-32279,-32468, -29888,-24983,-18435,-10944, -3223,  4161, 10757, 16326, 20745, 24069,  26399, 27942, 28869, 29396, 29643, 29756, 29747, 29678, 29452, 29053,  28312, 27175, 25460, 23135, 20088, 16364, 11974,  7077,  1815, -3589,  -8902,-13942,-18461,-22405,-25589,-28134,-29919,-31227,-31945,-32460, -32594,-32768,-32685,-32749,-32499,-32292,-31526,-30504,-28525,-25888, -21924,-17027,-10771, -3718,  -613,  5923, 13254, 19633, 25292, 28734,  30041, 28128, 23483, 15893,  6717, -3180,-12647,-21262,-27565,-31477, -32710,-31826,-29116,-25298,-20786,-16132,-11645, -7612, -4188, -1454,    524,  1791,  2300,  2135,  1245,  -266, -2444, -5154, -8403,-11991, -15845,-19713,-23440,-26759,-29498,-31441,-32500,-32593,-31764,-30103, -27787,-25016,-22034,-19068,-16319,-13964,-12119,-10887,-10314,-10444, -11283,-12832,-15047,-17845,-21060,-24460,-27711,-30423,-32157,-32490, -31078,-27710,-22382,-15310, -6944,  2065, 10935, 18850, 25047, 28944,  30203, 28782, 24953, 19237, 12359,  5105, -1742, -8031,-13617,-18231, -21849,-24543,-26456,-27734,-28508,-28879,-28901,-28588,-27916,-26832, -25267,-23135,-20394,-17002,-13015, -8499, -3715
; fm synth 38
.dw 3539, 13895, 23357, 29920, 32662, 31913, 28856, 24931, 21323,  18858, 17881, 18399, 20126, 22635, 25393, 27892, 29808, 31029, 31646,  31790, 31456, 30402, 28080, 23879, 17271,  8317, -2182,-12756,-21828, -28311,-31777,-32767,-32254,-31292,-30626,-30601,-31171,-31990,-32629, -32729,-32196,-31191,-30121,-29415,-29424,-30206,-31503,-32603,-32477, -29984,-24374,-15657, -5199,  5140, 14390, 21441, 26028, 28635, 29811,  30052, 29494, 28097, 25687, 22270, 18077, 13632,  9635,  6695,  5259,   5650,  7980, 12206, 17842, 24008, 29307, 32368, 32364, 29318, 24065,  17889, 12047,  7475,  4688,  3817,  4849,  7534, 11488, 16105, 20762,  24844, 27934, 29947, 31029, 31422, 31254, 30397, 28466, 24936, 19462,  12044,  3237, -5872,-14180,-20810,-25436,-28266,-29699,-30130,-29747, -28470,-26067,-22326,-17314,-11407, -5269,   329,  4827,  7796,  9024,   8418,  5957,  1680, -4200,-11105,-18186,-24449,-29071,-31760,-32731, -32595,-32122,-31875,-32074,-32548,-32758,-32032,-29825,-25923,-20645, -14716, -9009, -4325, -1180,   160,  -418, -2861, -6959,-12229,-18057, -23582,-28033,-30975,-32413,-32768,-32631,-32512,-32612,-32768,-32442, -30927,-27587,-22241,-15221, -7416,   145,  6640, 11489, 14524, 15777,  15342, 13281,  9662,  4710, -1171, -7331,-13065,-17850,-21316,-23394, -24121,-23495,-21376,-17472,-11666, -3738,  6072, 15840, 23598, 28714,  31423, 32497, 32753, 32767, 32765, 32646, 32110, 30839, 28686, 25819,  22710, 19994, 18306, 18077, 19519, 22484, 26392, 30192, 32523, 32191,  28540, 21893, 13338,  4433, -3583, -9908,-14211,-16604,-17281,-16446, -14257,-10923, -6781, -2310,  1897,  5318,  7532,  8206,  7123,  4091,   -888, -7684,-15578,-23383,-29492,-32569,-31889,-27789,-21549,-14818,  -9035, -4935, -2837, -2635, -4139, -6993,-10773,-14882,-18707,-21770, -23822,-24743,-24484,-22808,-19383,-13732, -5917
; granular 16
.dw 19281, 31324, 26351, 29220, 26476, 28267, 26218, 27503, 25862,  26777, 25461, 26090, 25021, 25437, 24551, 24798, 24066, 24182, 23558,  23588, 23017, 23021, 22461, 22477, 21883, 21944, 21290, 21427, 20690,  20923, 20073, 20427, 19457, 19936, 18834, 19466, 18134, 19278, 15518, -15223,-18125,-16440,-17305,-16032,-16701,-15552,-16118,-15067,-15532, -14582,-14942,-14101,-14350,-13614,-13762,-13125,-13179,-12626,-12602, -12121,-12039,-11605,-11489,-11070,-10953,-10527,-10431, -9973, -9918,  -9400, -9428, -8811, -8964, -8185, -8553, -7436, -8478, -4836,  7526,   6975,  6882,  6563,  6252,  6081,  5655,  5569,  5088,  5036,  4534,   4488,  3987,  3938,  3449,  3379,  2915,  2818,  2385,  2255,  1856,   1693,  1327,  1133,   794,   580,   246,     0,     3,    -7,    10,    -12,    13,   -15,    16,   -17,    18,   -18,    17,   -16,    15,    -14,    13,   -11,    10,    -8,     7,    -6,     3,    -1,    -1,      5,    -9,   164,   451,   722,   991,  1272,  1533,  1823,  2077,   2372,  2617,  2919,  3161,  3465,  3704,  4010,  4248,  4553,  4792,   5092,  5338,  5630,  5885,  6164,  6435,  6693,  6987,  7219,  7538,   7742,  8093,  8266,  8646,  8785,  9199,  9307,  9749,  9831, 10292,  10361, 10829, 10897, 11354, 11441, 11872, 11999, 12373, 12571, 12854,  13160, 13320, 13769, 13757, 14408, 14153, 15094, 14492, 15861, 14702,  16864, 14411, 19296,  2676,-19622,-15691,-18196,-17053,-18262,-17902, -18581,-18602,-18983,-19231,-19437,-19826,-19919,-20387,-20424,-20923, -20949,-21444,-21485,-21949,-22027,-22450,-22577,-22941,-23128,-23431, -23676,-23927,-24214,-24428,-24744,-24938,-25265,-25460,-25769,-25994, -26257,-26545,-26733,-27104,-27194,-27672,-27649,-28254,-28049,-28524, -27968,-28573,-27888,-28607,-27815,-28633,-27762,-28643,-27729,-28609, -27740,-28537,-27825,-28367,-28006,-28033,-27832